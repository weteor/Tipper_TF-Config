## boards/arm/tipper_tf/Kconfig.board
```kconfig
# Tipper TF board configuration
# Copyright (c) 2021 weteor
# SPDX-License-Identifier: MIT

config BOARD_TIPPER_TF
        bool "Tipper_TF"
        depends on SOC_NRF52840_QIAA
```

## drivers/Kconfig
```kconfig
# Copyright (c) 2020 The ZMK Contributors
# SPDX-License-Identifier: MIT

rsource "display/Kconfig"
```
